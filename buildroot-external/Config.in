## buildroot-external/package/retroarch/Config.in
```kconfig
# Libretro cores and retroarch
source "$BR2_EXTERNAL_RETROOPI_PATH/package/retroarch/retroarch/Config.in"

if BR2_PACKAGE_RETROARCH
menu "Retroarch Cores"
	source "$BR2_EXTERNAL_RETROOPI_PATH/package/retroarch/libretro-4do/Config.in"
	source "$BR2_EXTERNAL_RETROOPI_PATH/package/retroarch/libretro-81/Config.in"
	source "$BR2_EXTERNAL_RETROOPI_PATH/package/retroarch/libretro-atari800/Config.in"
	source "$BR2_EXTERNAL_RETROOPI_PATH/package/retroarch/libretro-armsnes/Config.in"
	source "$BR2_EXTERNAL_RETROOPI_PATH/package/retroarch/libretro-beetlelynx/Config.in"
	source "$BR2_EXTERNAL_RETROOPI_PATH/package/retroarch/libretro-beetlengp/Config.in"
	source "$BR2_EXTERNAL_RETROOPI_PATH/package/retroarch/libretro-beetlepcefast/Config.in"
	source "$BR2_EXTERNAL_RETROOPI_PATH/package/retroarch/libretro-beetlepcfx/Config.in"
	source "$BR2_EXTERNAL_RETROOPI_PATH/package/retroarch/libretro-beetlepsx/Config.in"
	source "$BR2_EXTERNAL_RETROOPI_PATH/package/retroarch/libretro-beetlesaturn/Config.in"
	source "$BR2_EXTERNAL_RETROOPI_PATH/package/retroarch/libretro-beetlesupergrafx/Config.in"
	source "$BR2_EXTERNAL_RETROOPI_PATH/package/retroarch/libretro-beetlevb/Config.in"
	source "$BR2_EXTERNAL_RETROOPI_PATH/package/retroarch/libretro-beetlewswan/Config.in"
	source "$BR2_EXTERNAL_RETROOPI_PATH/package/retroarch/libretro-bluemsx/Config.in"
	source "$BR2_EXTERNAL_RETROOPI_PATH/package/retroarch/libretro-bnes/Config.in"
	source "$BR2_EXTERNAL_RETROOPI_PATH/package/retroarch/libretro-bsnes/Config.in"
	source "$BR2_EXTERNAL_RETROOPI_PATH/package/retroarch/libretro-cap32/Config.in"
	source "$BR2_EXTERNAL_RETROOPI_PATH/package/retroarch/libretro-dosbox/Config.in"
	source "$BR2_EXTERNAL_RETROOPI_PATH/package/retroarch/libretro-fbalpha/Config.in"
	source "$BR2_EXTERNAL_RETROOPI_PATH/package/retroarch/libretro-fbalpha2012/Config.in"
	source "$BR2_EXTERNAL_RETROOPI_PATH/package/retroarch/libretro-fceumm/Config.in"
	source "$BR2_EXTERNAL_RETROOPI_PATH/package/retroarch/libretro-fceunext/Config.in"
	source "$BR2_EXTERNAL_RETROOPI_PATH/package/retroarch/libretro-flycast/Config.in"
	source "$BR2_EXTERNAL_RETROOPI_PATH/package/retroarch/libretro-fmsx/Config.in"
	source "$BR2_EXTERNAL_RETROOPI_PATH/package/retroarch/libretro-fuse/Config.in"
	source "$BR2_EXTERNAL_RETROOPI_PATH/package/retroarch/libretro-gambatte/Config.in"
	source "$BR2_EXTERNAL_RETROOPI_PATH/package/retroarch/libretro-gearboy/Config.in"
	source "$BR2_EXTERNAL_RETROOPI_PATH/package/retroarch/libretro-genesisplusgx/Config.in"
	source "$BR2_EXTERNAL_RETROOPI_PATH/package/retroarch/libretro-gpsp/Config.in"
	source "$BR2_EXTERNAL_RETROOPI_PATH/package/retroarch/libretro-gw/Config.in"
	source "$BR2_EXTERNAL_RETROOPI_PATH/package/retroarch/libretro-hatari/Config.in"
	source "$BR2_EXTERNAL_RETROOPI_PATH/package/retroarch/libretro-lutro/Config.in"
	source "$BR2_EXTERNAL_RETROOPI_PATH/package/retroarch/libretro-mame/Config.in"
	source "$BR2_EXTERNAL_RETROOPI_PATH/package/retroarch/libretro-mame2000/Config.in"
	source "$BR2_EXTERNAL_RETROOPI_PATH/package/retroarch/libretro-mame2003/Config.in"
	source "$BR2_EXTERNAL_RETROOPI_PATH/package/retroarch/libretro-mame2003plus/Config.in"
	source "$BR2_EXTERNAL_RETROOPI_PATH/package/retroarch/libretro-mame2010/Config.in"
	source "$BR2_EXTERNAL_RETROOPI_PATH/package/retroarch/libretro-mame2014/Config.in"
	source "$BR2_EXTERNAL_RETROOPI_PATH/package/retroarch/libretro-mame2016/Config.in"
	source "$BR2_EXTERNAL_RETROOPI_PATH/package/retroarch/libretro-meteor/Config.in"
	source "$BR2_EXTERNAL_RETROOPI_PATH/package/retroarch/libretro-mgba/Config.in"
	source "$BR2_EXTERNAL_RETROOPI_PATH/package/retroarch/libretro-mupen64plus/Config.in"
	source "$BR2_EXTERNAL_RETROOPI_PATH/package/retroarch/libretro-mupen64plus-nx/Config.in"
	source "$BR2_EXTERNAL_RETROOPI_PATH/package/retroarch/libretro-nestopia/Config.in"
	source "$BR2_EXTERNAL_RETROOPI_PATH/package/retroarch/libretro-nxengine/Config.in"
	source "$BR2_EXTERNAL_RETROOPI_PATH/package/retroarch/libretro-o2em/Config.in"
	source "$BR2_EXTERNAL_RETROOPI_PATH/package/retroarch/libretro-paralleln64/Config.in"
	source "$BR2_EXTERNAL_RETROOPI_PATH/package/retroarch/libretro-pcsx/Config.in"
	source "$BR2_EXTERNAL_RETROOPI_PATH/package/retroarch/libretro-picodrive/Config.in"
	source "$BR2_EXTERNAL_RETROOPI_PATH/package/retroarch/libretro-ppsspp/Config.in"
	source "$BR2_EXTERNAL_RETROOPI_PATH/package/retroarch/libretro-prboom/Config.in"
	source "$BR2_EXTERNAL_RETROOPI_PATH/package/retroarch/libretro-prosystem/Config.in"
	source "$BR2_EXTERNAL_RETROOPI_PATH/package/retroarch/libretro-quicknes/Config.in"
	source "$BR2_EXTERNAL_RETROOPI_PATH/package/retroarch/libretro-scummvm/Config.in"
	source "$BR2_EXTERNAL_RETROOPI_PATH/package/retroarch/libretro-snes9x/Config.in"
	source "$BR2_EXTERNAL_RETROOPI_PATH/package/retroarch/libretro-snes9x2002/Config.in"
	source "$BR2_EXTERNAL_RETROOPI_PATH/package/retroarch/libretro-snes9x2005/Config.in"
	source "$BR2_EXTERNAL_RETROOPI_PATH/package/retroarch/libretro-snes9x2010/Config.in"
	source "$BR2_EXTERNAL_RETROOPI_PATH/package/retroarch/libretro-stella/Config.in"
	source "$BR2_EXTERNAL_RETROOPI_PATH/package/retroarch/libretro-stella2023/Config.in"
	source "$BR2_EXTERNAL_RETROOPI_PATH/package/retroarch/libretro-tgbdual/Config.in"
	source "$BR2_EXTERNAL_RETROOPI_PATH/package/retroarch/libretro-uae/Config.in"
	source "$BR2_EXTERNAL_RETROOPI_PATH/package/retroarch/libretro-vbam/Config.in"
	source "$BR2_EXTERNAL_RETROOPI_PATH/package/retroarch/libretro-vbanext/Config.in"
	source "$BR2_EXTERNAL_RETROOPI_PATH/package/retroarch/libretro-vecx/Config.in"
	source "$BR2_EXTERNAL_RETROOPI_PATH/package/retroarch/libretro-virtualjaguar/Config.in"
endmenu
endif
```

## buildroot-external/package/retroarch/libretro-atari800/Config.in
```kconfig
config BR2_PACKAGE_LIBRETRO_ATARI800
	bool "libretro-atari800"
	depends on BR2_PACKAGE_RETROARCH
	help
	  libretro atari800 core: Atari 8-bit computers (400/800/XL/XE) and
	  the Atari 5200 console.

	  Handles .atr / .xex / .a52 / .cas images.
```

## buildroot-external/package/retroarch/libretro-flycast/Config.in
```kconfig
config BR2_PACKAGE_LIBRETRO_FLYCAST
	bool "libretro-flycast"
	depends on BR2_PACKAGE_RETROARCH
	depends on BR2_INSTALL_LIBSTDCPP
	depends on BR2_PACKAGE_HAS_LIBGLES
	select BR2_PACKAGE_ZLIB
	help
	  Flycast: Sega Dreamcast, NAOMI and Atomiswave emulator,
	  libretro core. Hardware rendering through GLES3.

	  https://github.com/flyinghead/flycast

comment "libretro-flycast needs a toolchain w/ C++ and GLES"
	depends on !BR2_INSTALL_LIBSTDCPP || !BR2_PACKAGE_HAS_LIBGLES
```

## buildroot-external/package/retroarch/libretro-ppsspp/Config.in
```kconfig
config BR2_PACKAGE_LIBRETRO_PPSSPP
	bool "libretro-ppsspp"
	depends on BR2_PACKAGE_RETROARCH
	depends on BR2_INSTALL_LIBSTDCPP
	depends on BR2_PACKAGE_HAS_LIBGLES
	select BR2_PACKAGE_LIBPNG
	select BR2_PACKAGE_ZLIB
	help
	  PPSSPP: Sony PlayStation Portable emulator, libretro core
	  (upstream hrydgard/ppsspp). Hardware rendering through GLES3.

	  https://www.ppsspp.org

comment "libretro-ppsspp needs a toolchain w/ C++ and GLES"
	depends on !BR2_INSTALL_LIBSTDCPP || !BR2_PACKAGE_HAS_LIBGLES
```

## buildroot-external/package/retroopi-launcher/Config.in
```kconfig
config BR2_PACKAGE_RETROOPI_LAUNCHER
	bool "retroopi-launcher"
	depends on BR2_PACKAGE_HAS_UDEV
	select BR2_PACKAGE_LIBDRM
	select BR2_PACKAGE_SDL2
	select BR2_PACKAGE_SDL2_TTF
	select BR2_PACKAGE_SDL2_IMAGE
	# sdl2_image only builds PNG support if libpng is selected, and the
	# launcher hard-fails on IMG_Init(IMG_INIT_PNG).
	select BR2_PACKAGE_LIBPNG
	select BR2_PACKAGE_FREETYPE
	help
	  Retro gaming launcher: DRM/KMS framebuffer UI with system browser,
	  ROM list, favourites, recents, themes, search keyboard and
	  save-state slot picker. Launches RetroArch and re-initialises on exit.

	  Ported from RetroBPI_M2M, which ported it from the LyraZeroW
	  SuperRetroPack project.

if BR2_PACKAGE_RETROOPI_LAUNCHER

config BR2_PACKAGE_RETROOPI_LAUNCHER_SCREEN_W
	int "output width"
	default 1280
	help
	  Width of the HDMI mode the launcher selects, and of its
	  framebuffer. The launcher picks the connector mode matching
	  SCREEN_W x SCREEN_H, so this must be a mode the display offers.
	  1280 for 720p, 1920 for 1080p.

config BR2_PACKAGE_RETROOPI_LAUNCHER_SCREEN_H
	int "output height"
	default 720
	help
	  Height of the HDMI mode the launcher selects. 720 or 1080.

endif
```

## buildroot-external/package/retroopi-tools/Config.in
```kconfig
config BR2_PACKAGE_RETROOPI_TOOLS
	bool "retroopi-tools"
	help
	  Small on-target helpers for this board:

	  inject-input -- synthesise key presses through /dev/uinput, so the
	  launcher and RetroArch can be driven from a shell over SSH. Injected
	  events travel the same evdev/udev path a real gamepad's do. Requires
	  CONFIG_INPUT_UINPUT.

	  core-info -- load a libretro core and print its library_name,
	  extensions and every core option with its allowed values, so .opt
	  files can be written from what the core really accepts.
```
